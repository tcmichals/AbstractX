// SPDX-License-Identifier: (GPL-2.0-only OR MIT)
// @impl [SPEC-E906-IPC-04] [SPEC-E906-CACHE-02] [SPEC-E906-MEM-01] targets/allwinner_e906/SPECIFICATION.md
/dts-v1/;
/plugin/;
/*
 * Radxa Cubie A5E: AbstractX RPMsg pool in on-chip SRAM ([SPEC-E906-IPC-04]).
 *
 * Gives Linux the UPPER half of E906 SRAM Space 1 as the remoteproc DMA pool:
 * host 0x072E0000-0x072FFFFF (E906 core 0x40020000-0x4003FFFF, 128 KB).
 * virtio_rpmsg_bus allocates both vrings and all RPMsg buffers there, so the
 * E906 trace and TLP endpoints write straight into SRAM: no DRAM, no copy, no
 * cache maintenance (E906 D-cache off, [SPEC-E906-CACHE-02]).
 *
 * The lower half of Space 1 (resource table, trace0) and all of Space 0 stay
 * with the firmware; tools/check_e906_layout.py fails the firmware build if
 * anything is linked into this pool.
 *
 * Stacking Order in /boot/config.txt:
 *   dtoverlay=cubie-a5e-flight-stack-e906 cubie-a5e-abstractx-rpmsg-sram
 *
 * NOTE: This is an internal memory-pool overlay and does not touch any 40-pin
 * header pins. Physical 40-pin I/O is governed by cubie-a5e-flight-stack-e906.dtso:
 *   - Pins 3 & 5   : I2C1 (PB5 SDA Blue, PB4 SCL Orange - Puck pull-ups)
 *   - Pins 8 & 10  : UART0 (PB9 TX, PB10 RX - Linux Serial Console)
 *   - Pins 16 & 31 : UART3 (PI11 TX Yellow -> GPS RX, PI12 RX Green <- GPS TX)
 *   - Pins 19,21,23,24: SPI1 (PB13 MOSI, PB14 MISO, PB12 CLK, PB11 CS0)
 *   - Pin 29       : IMU DRDY (PI8 / EINT8)
 */

&{/reserved-memory} {
    #address-cells = <2>;
    #size-cells = <2>;
    ranges;

    abx_rpmsg_pool: abx-rpmsg-pool@72e0000 {
        compatible = "shared-dma-pool";
        reg = <0x0 0x072e0000 0x0 0x20000>;
        no-map;
    };
};

&rproc {
    memory-region = <&abx_rpmsg_pool>;
};
