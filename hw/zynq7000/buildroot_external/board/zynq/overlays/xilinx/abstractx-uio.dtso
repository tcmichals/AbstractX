/dts-v1/;
/plugin/;

/* Default AbstractX BRAM FIFO CSR/IRQ contract. */

/ {
	fragment@0 {
		target = <&amba>;
		__overlay__ {
			#address-cells = <1>;
			#size-cells = <1>;
			abstractx_fpga: fpga-fabric@40000000 {
				compatible = "generic-uio";
				reg = <0x40000000 0x00010000>;
				reg-names = "csr";
				interrupt-parent = <&intc>;
				interrupts = <0 29 4>;
				abstractx,memory-mode = "bram";
				abstractx,slot-size = <64>;
				abstractx,ingress-capacity = <128>;
				abstractx,egress-capacity = <128>;
				abstractx,tlp-size = <64>;
				abstractx,integrity-footer = "reserved-zero";
				abstractx,trace-channel = <0x04>;
				status = "okay";
			};
		};
	};
};
